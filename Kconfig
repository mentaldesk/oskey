## Kconfig
```kconfig
DT_COMPAT_ZMK_BEHAVIOR_OS_SELECTOR := zmk,behavior-os-selector
DT_COMPAT_ZMK_BEHAVIOR_OS_KEY := zmk,behavior-os-key
DT_COMPAT_ZMK_BEHAVIOR_HOLD_FN := zmk,behavior-hold-fn

config ZMK_BEHAVIOR_OS_SELECTOR
    bool
    default $(dt_compat_enabled,$(DT_COMPAT_ZMK_BEHAVIOR_OS_SELECTOR))

config ZMK_BEHAVIOR_OS_KEY
    bool
    default $(dt_compat_enabled,$(DT_COMPAT_ZMK_BEHAVIOR_OS_KEY))

config ZMK_BEHAVIOR_HOLD_FN
    bool
    default $(dt_compat_enabled,$(DT_COMPAT_ZMK_BEHAVIOR_HOLD_FN))

config ZMK_OSKEY_STATE
    bool
    default y if ZMK_BEHAVIOR_OS_SELECTOR || ZMK_BEHAVIOR_OS_KEY

choice ZMK_OSKEY_DEFAULT_OS
    prompt "Default OS"
    default ZMK_OSKEY_DEFAULT_OS_WINDOWS
    depends on ZMK_OSKEY_STATE

config ZMK_OSKEY_DEFAULT_OS_WINDOWS
    bool "Windows"

config ZMK_OSKEY_DEFAULT_OS_MACOS
    bool "macOS"

config ZMK_OSKEY_DEFAULT_OS_LINUX
    bool "Linux"

endchoice
```

## dts/bindings/behaviors/zmk,behavior-hold-fn.yaml
```yaml
description: |
  Hold-Fn Behavior

  Holds the Fn/Globe key (C_AC_NEXT_KEYBOARD_LAYOUT_SELECT) while pressing
  and releasing a single child binding.  Intended for macOS window-management
  shortcuts that require Fn held alongside another key combination.

  Example — Tile Left (Globe+Ctrl+Left on macOS):

    mac_tile_left: mac_fn_tile_left {
        compatible = "zmk,behavior-hold-fn";
        #binding-cells = <0>;
        bindings = <&kp GLOBE>, <&kp LC(LEFT)>;
    };

  Use this as the macOS binding inside a zmk,behavior-os-key:

    ok_win_tile_left: os_key_win_tile_left {
        compatible = "zmk,behavior-os-key";
        #binding-cells = <0>;
        /*                   Win                   Mac                    Lin  */
        bindings = <&kp LG(LEFT)>, <&mac_tile_left>, <&none>;
    };

compatible: "zmk,behavior-hold-fn"

include: zero_param.yaml

properties:
  bindings:
    type: phandle-array
    required: true
    description: |
      Two behavior bindings:
        1. hold-binding — held down for the duration (e.g. &kp GLOBE)
        2. tap-binding  — pressed then released while hold-binding is active (e.g. &kp LC(LEFT))
```

## dts/bindings/behaviors/zmk,behavior-os-key.yaml
```yaml
description: |
  OS Key Behavior

  Dispatches to one of three bindings depending on the currently selected
  operating system (set via the os-selector behavior).

  The bindings property takes exactly three entries in order:
    1. Windows binding
    2. macOS binding
    3. Linux binding

  Example — a key that sends Ctrl on Windows/Linux but Cmd (GUI) on macOS:

    oskey_ctrl_cmd: os_key_ctrl_cmd {
        compatible = "zmk,behavior-os-key";
        #binding-cells = <0>;
        bindings = <&kp LCTRL>, <&kp LGUI>, <&kp LCTRL>;
    };

  Then in the keymap layer:

    &oskey_ctrl_cmd

compatible: "zmk,behavior-os-key"

include: zero_param.yaml

properties:
  bindings:
    type: phandle-array
    required: true
    description: |
      Three behavior bindings in order: Windows, macOS, Linux.
```

## dts/bindings/behaviors/zmk,behavior-os-layer-mod.yaml
```yaml
description: |
  OS Layer Mod Behavior

  A hold-tap behavior designed for OS-agnostic app switching.

  Hold: activates the specified layer AND holds an OS-specific modifier key
  (configured via the `bindings` property), keeping the OS switcher menu open
  for as long as the key is physically held.

  Tap: sends a regular keycode (the key's normal function).

  On release: deactivates the layer and releases the modifier, which
  confirms the app selection and dismisses the OS switcher menu.

  The `bindings` property takes exactly three entries (Windows, macOS, Linux)
  specifying which modifier to hold for each OS. The default `&ok_ltm` instance
  in `oskey.dtsi` uses Left Alt on Windows/Linux and Left GUI (Command) on macOS,
  matching the standard app-switcher modifier for each OS. Override `bindings`
  in your keymap if you need different modifiers.

  Example — hold for app-switch layer, tap for G, with custom modifiers:

    my_ltm: os_layer_mod {
        compatible = "zmk,behavior-os-layer-mod";
        #binding-cells = <2>;
        tapping-term-ms = <200>;
        /*             Win         Mac         Lin  */
        bindings = <&kp LALT>, <&kp LGUI>, <&kp LALT>;
    };

  Then in a keymap layer:

    &my_ltm APP_SWITCH_LAYER G

compatible: "zmk,behavior-os-layer-mod"

include: two_param.yaml

properties:
  bindings:
    type: phandle-array
    required: true
    description: |
      Three modifier behavior bindings in order: Windows, macOS, Linux.
      The selected binding will be held for the duration of the layer activation.

      Example (default app-switch modifiers):
        bindings = <&kp LALT>, <&kp LGUI>, <&kp LALT>;

  tapping-term-ms:
    type: int
    required: true
    description: |
      Milliseconds between key-down and the hold decision.
      Releasing before this threshold sends the tap keycode.
      Holding past it activates the layer and holds the modifier.
```

## dts/bindings/behaviors/zmk,behavior-os-selector.yaml
```yaml
description: |
  OS Selector Behavior

  Selects the current operating system so that os-key behaviors dispatch
  to the correct per-OS binding.

  Example usage in a keymap behaviors block:

    os_sel: os_selector {
        compatible = "zmk,behavior-os-selector";
        #binding-cells = <1>;
    };

  Then bind it with the OS constant as the parameter:

    &os_sel OS_WIN
    &os_sel OS_MAC
    &os_sel OS_LIN

  (requires #include <dt-bindings/zmk/oskey.h> in the keymap file)

compatible: "zmk,behavior-os-selector"

include: one_param.yaml
```

## tests/manifest/west.yml
```yaml
manifest:
  projects:
    - name: zmk
      url: https://github.com/zmkfirmware/zmk
      revision: 0331b7d16e80954b807917f9323e59ffc1e3b626
      import:
        file: app/west.yml
  self:
    path: manifest
```

## tests/west.yml
```yaml
manifest:
  projects:
    - name: zmk
      url: https://github.com/zmkfirmware/zmk
      revision: main
      import:
        file: app/west.yml
  self:
    path: tests
```
