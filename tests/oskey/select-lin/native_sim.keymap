#include "../behavior_keymap.dtsi"

/* Select Linux (row=1, col=0), then press okctrl (row=1, col=1). */
&kscan {
    events = <
        ZMK_MOCK_PRESS(1,0,10)
        ZMK_MOCK_RELEASE(1,0,10)
        ZMK_MOCK_PRESS(1,1,10)
        ZMK_MOCK_RELEASE(1,1,10)
    >;
};
